## arch/arm/mach-msm/lge/Kconfig.board
```kconfig
#
# Inlcude the specific Kconfig file for LGE board
#

# GK
source "arch/arm/mach-msm/lge/gk/Kconfig"

config MACH_LGE_DUMMY
	bool "NONE (No device)"
```
